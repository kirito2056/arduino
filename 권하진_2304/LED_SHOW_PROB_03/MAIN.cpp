#include "COMMON.h"
#include "TASK_SIMPLE.h"
#define MAX_SHOW_COUNT 32

LED_SHOW_INFO LED_TASKS[MAX_SHOW_COUNT];

bool ONE_LED_SHOW_COMPLETED = false;

void INIT_LED_TASKS() {
	for (int i=0; i<MAX_SHOW_COUNT; i++) {
		LED_TASKS[i].ENABLE		= false;
		LED_TASKS[i].FLAG_1ST	= false;
		LED_TASKS[i].PLAY_MAX	= 3;
		LED_TASKS[i].PLAY_CURR	= 0;
	}
}

int SHOW_NUMBER = -1;
void LED_SHOW_SELECTOR() {
	if (!ONE_LED_SHOW_COMPLETED) return;
	ONE_LED_SHOW_COMPLETED = false;
//	SHOW_NUMBER = random(2);
	SHOW_NUMBER = (SHOW_NUMBER + 1) % 2;
	LED_TASKS[SHOW_NUMBER].ENABLE = true;
}

int TIME_LOOP[] = {250, 70};
int PATTERN_MAX[] = {2, 8};
int PATTERN_00[] = { 0b11111111, 0b00000000 };
int PATTERN_01[] = { 0b00011000, 0b00100100, 0b01000010, 0b10000001, 0b010000010, 0b0010000100, 0b0001001000, 0b00011000 };

int *PATTERN_2D[] = {
	PATTERN_00, PATTERN_01
};

void LED_SHOW() {

	TASK_INFO *P = TASK_SIMPLE::GET_TASK_INFO(1);
	P->TIME_LOOP = TIME_LOOP[SHOW_NUMBER];

	if (!LED_TASKS[SHOW_NUMBER].ENABLE) return;
	if (!LED_TASKS[SHOW_NUMBER].FLAG_1ST) {
		LED_TASKS[SHOW_NUMBER].PATTERN = PATTERN_2D[SHOW_NUMBER];
		LED_TASKS[SHOW_NUMBER].PATTERN_MAX = PATTERN_MAX[SHOW_NUMBER];
		LED_TASKS[SHOW_NUMBER].PATTERN_INDEX = 0;
		LED_TASKS[SHOW_NUMBER].FLAG_1ST = true;
	}

	int INDEX = LED_TASKS[SHOW_NUMBER].PATTERN_INDEX;
	PORTE = LED_TASKS[SHOW_NUMBER].PATTERN[INDEX];
	
	LED_TASKS[SHOW_NUMBER].PATTERN_INDEX += 1;
	
	if (LED_TASKS[SHOW_NUMBER].PATTERN_INDEX >= LED_TASKS[SHOW_NUMBER].PATTERN_MAX) {
		LED_TASKS[SHOW_NUMBER].PATTERN_INDEX = 0;
		LED_TASKS[SHOW_NUMBER].PLAY_CURR += 1;
	}
	
	if (LED_TASKS[SHOW_NUMBER].PLAY_CURR >= LED_TASKS[SHOW_NUMBER].PLAY_MAX) {
		LED_TASKS[SHOW_NUMBER].ENABLE = false;
		LED_TASKS[SHOW_NUMBER].PLAY_CURR  = 0;
		ONE_LED_SHOW_COMPLETED = true;
	}
}

void setup() {
	DDRE = 0b11111111;
	
	INIT_LED_TASKS();
	
	TASK_SIMPLE::SETUP();
	TASK_SIMPLE::NEW_TASK(LED_SHOW_SELECTOR,  0, 100,  100);
	TASK_SIMPLE::NEW_TASK(LED_SHOW,  1, 100,  250);  
		
	ONE_LED_SHOW_COMPLETED = true;
}


void loop() {
  TASK_SIMPLE::LOOP();
}
